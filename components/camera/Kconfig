## components/camera/Kconfig
```kconfig
menu "Camera Configuration"

    config CAMERA_PIN_PWDN
        int "PWDN GPIO（未接则填 -1）"
        range -1 48
        default -1
        help
            板级 pinout 图上没有标出该信号，按未连接处理。

    config CAMERA_PIN_RESET
        int "RESET GPIO（未接则填 -1）"
        range -1 48
        default -1
        help
            板级 pinout 图上没有标出该信号，按未连接处理。

    config CAMERA_PIN_XCLK
        int "XCLK GPIO"
        range -1 48
        default 15
        help
            默认值来自 ICGOICIC ESP32-S3-WROOM N16R8 CAM 板级 pinout 图（CAM_XCLK），
            与常见同类板子流传的引脚定义一致，但未经本机实测，如初始化失败请用万用
            表对 FPC 插座做导通测试核实。

    config CAMERA_PIN_SIOD
        int "SIOD(SDA) GPIO"
        range -1 48
        default 4
        help
            默认值来自板级 pinout 图（CAM_SIOD），未经本机实测。

    config CAMERA_PIN_SIOC
        int "SIOC(SCL) GPIO"
        range -1 48
        default 5
        help
            默认值来自板级 pinout 图（CAM_SIOC），未经本机实测。

    config CAMERA_PIN_D0
        int "D0 GPIO"
        range -1 48
        default 11
        help
            默认值来自板级 pinout 图（CAM_Y2 对应 D0），未经本机实测。

    config CAMERA_PIN_D1
        int "D1 GPIO"
        range -1 48
        default 9
        help
            默认值来自板级 pinout 图（CAM_Y3 对应 D1），未经本机实测。

    config CAMERA_PIN_D2
        int "D2 GPIO"
        range -1 48
        default 8
        help
            默认值来自板级 pinout 图（CAM_Y4 对应 D2），未经本机实测。

    config CAMERA_PIN_D3
        int "D3 GPIO"
        range -1 48
        default 10
        help
            默认值来自板级 pinout 图（CAM_Y5 对应 D3），未经本机实测。

    config CAMERA_PIN_D4
        int "D4 GPIO"
        range -1 48
        default 12
        help
            默认值来自板级 pinout 图（CAM_Y6 对应 D4），未经本机实测。

    config CAMERA_PIN_D5
        int "D5 GPIO"
        range -1 48
        default 18
        help
            默认值来自板级 pinout 图（CAM_Y7 对应 D5），未经本机实测。

    config CAMERA_PIN_D6
        int "D6 GPIO"
        range -1 48
        default 17
        help
            默认值来自板级 pinout 图（CAM_Y8 对应 D6），未经本机实测。

    config CAMERA_PIN_D7
        int "D7 GPIO"
        range -1 48
        default 16
        help
            默认值来自板级 pinout 图（CAM_Y9 对应 D7），未经本机实测。

    config CAMERA_PIN_VSYNC
        int "VSYNC GPIO"
        range -1 48
        default 6
        help
            默认值来自板级 pinout 图（CAM_VSYNC），未经本机实测。

    config CAMERA_PIN_HREF
        int "HREF GPIO"
        range -1 48
        default 7
        help
            默认值来自板级 pinout 图（CAM_HREF），未经本机实测。

    config CAMERA_PIN_PCLK
        int "PCLK GPIO"
        range -1 48
        default 13
        help
            默认值来自板级 pinout 图（CAM_PCLK），未经本机实测。

    config CAMERA_XCLK_FREQ_HZ
        int "XCLK 频率（Hz）"
        default 20000000
        help
            OV3660 常用 20MHz；如遇初始化失败或花屏，可尝试降到 10000000（10MHz）。

endmenu
```
