## components/mqtt_bridge/Kconfig
```kconfig
menu "MQTT Bridge Configuration"

    config MQTT_BRIDGE_BROKER_URI
        string "MQTT Broker URI"
        default "mqtts://989e0b4e491b4f6ab4c135931ceb0007.s1.eu.hivemq.cloud:8883"
        help
            HiveMQ Cloud 集群地址，强制 TLS（mqtts://，端口 8883）。
            登录用户名/密码见 mqtt_secrets.h.example。
            换 Broker 只需改这一项，代码不用动。

    config MQTT_BRIDGE_CMD_TOPIC
        string "拍照指令 Topic"
        default "esp32cam/s3/capture/cmd"
        help
            订阅此 topic，收到任意消息即触发一次拍照。

    config MQTT_BRIDGE_IMAGE_TOPIC
        string "图片发布 Topic"
        default "esp32cam/s3/capture/image"
        help
            拍到的 JPEG 原始数据发布到此 topic。

endmenu
```

## components/servo/Kconfig
```kconfig
menu "Servo Configuration"

    config SERVO_PIN
        int "舵机信号线 GPIO"
        range 0 48
        default 1
        help
            板子上剩余可用引脚不多（1、2、14、21、41、42、47），默认用 GPIO1。
            接线见 docs/wiring.md。

    config SERVO_MIN_PULSE_US
        int "0 度对应的脉宽（微秒）"
        range 100 2000
        default 500
        help
            标准 RC 舵机一般是 500us 对应 0 度。不同品牌有差异，
            如果转不到位或者转过头，调这两个值。

    config SERVO_MAX_PULSE_US
        int "180 度对应的脉宽（微秒）"
        range 1000 3000
        default 2500

endmenu
```

## components/storage/Kconfig
```kconfig
menu "Storage Configuration"

    config STORAGE_MOUNT_POINT
        string "SD 卡挂载点"
        default "/sdcard"

    config STORAGE_PIN_CLK
        int "SD CLK GPIO"
        range 0 48
        default 39
        help
            默认值来自板级 pinout 图（SD_CLK）。板载 microSD 走 SDMMC 1-bit 模式。

    config STORAGE_PIN_CMD
        int "SD CMD GPIO"
        range 0 48
        default 38
        help
            默认值来自板级 pinout 图（SD_CMD）。

    config STORAGE_PIN_D0
        int "SD DATA0 GPIO"
        range 0 48
        default 40
        help
            默认值来自板级 pinout 图（SD_DATA）。1-bit 模式只用 DAT0。

    config STORAGE_FREQ_KHZ
        int "SD 时钟频率（kHz）"
        default 20000
        help
            默认 20MHz。接触不良或杜邦线较长时可降到 10000（10MHz）试试。

endmenu
```

## components/stream_service/Kconfig
```kconfig
menu "Stream Service Configuration"

    config STREAM_SERVICE_INTERVAL_MS
        int "连续推流的帧间隔（毫秒）"
        range 50 10000
        default 50
        help
            推流开启时每隔多久拍一帧。实际帧率还受拍照耗时和网络往返限制，
            填太小不会更快，只会让任务空转。200ms 对应目标 5fps。

endmenu
```

## components/wifi/Kconfig
```kconfig
menu "WiFi Configuration"

    config WIFI_CONNECT_TIMEOUT_MS
        int "WiFi 连接超时时间（毫秒）"
        default 15000
        help
            wifi_init() 等待连接成功的最长时间，超时后返回 ESP_ERR_TIMEOUT。
            SSID/密码不在这里配置，见 wifi_secrets.h.example。

endmenu
```
